## drivers/Kconfig
```kconfig
menu "Drivers"
	config EXYNOS_ACPM
		bool "Support for Samsung Exynos ACPM block"
		default n
		help
		    Say Y if you have a device with the Samsung Exynos ACPM block.

	config EXYNOS_WDT
		bool "Support for the Samsung Exynos watchdog"
		default n
		help
		    Say Y to arm the s3c2410-style Exynos watchdog from the board
		    file (e.g. for the failsafe).

	config SAMSUNG_SBOOT
		bool "Support for Samsung S-BOOT reboot targets"
		default n
		help
		    Say Y to reset into BOOT, RECOVERY or Download mode through the
		    PMU INFORM register that Samsung's S-BOOT reads.

	config EXYNOS_SPEEDY
		bool "Support for Samsung Exynos SPEEDY bus"
		default n
		help
		    Say Y if you have a device with the Samsung Exynos SPEEDY bus.

	config MEDIATEK_MCUSYS
		bool "Support for MediaTek MCUSYS"
		depends on MEDIATEK
		default n
		help
		  Say Y if you have a device with a MediaTek SoC and need to use
		  hardware behind MCUSYS.

	menuconfig TIMER
		bool "Timer support"
		default n
		help
		  Say Y here to enable support for timer drivers. Enabling this
		  option alone won't add any code to the resulting binary.

source "drivers/timer/Kconfig"

endmenu
```

## lib/Kconfig
```kconfig
menu "Libraries"
	config SIMPLE_FB
		bool "Support for Simple Framebuffer"
		default y
		help
		  Say Y if you want to have Framebuffer output.

	config SIMPLE_FB_KEEP_SCREEN
		bool "Keep the bootloader's picture on the framebuffer"
		depends on SIMPLE_FB
		default n
		help
		  Do not clear the framebuffer at probe: the loader text is drawn
		  over whatever the previous bootloader left there (e.g. the boot
		  logo). Only the set glyph pixels are written. The screen is still
		  cleared once if the text reaches the bottom and wraps.

	config EARLYCON
		bool "Support for UART early console"
		default n
		help
		  Say Y if you want to have UART early console output. Keep
		  in mind that your board files need to provide uart_puts
		  functionality in order for this to work.

	config RAMLOG
		bool "Keep the loader log in a ramoops console zone"
		default n
		help
		  Append every printk to a Linux ramoops (pstore) console zone in
		  RAM that survives resets. The next kernel with the same ramoops
		  geometry shows the previous kernel's log followed by the loader
		  lines in /sys/fs/pstore/console-ramoops-0. ARMv8 only.

	config RAMLOG_ADDR
		hex "Address of the ramoops console zone"
		depends on RAMLOG

	config RAMLOG_SIZE
		hex "Size of the ramoops console zone"
		depends on RAMLOG

	config RAMLOG_TAIL
		int "Bytes of the previous log printed on a failure"
		default 2400
		depends on RAMLOG

	config FAILSAFE
		bool "Failsafe: watchdog, boot-loop breaker, escape slot"
		default n
		help
		  For devices that cannot be reset by hand. Arms a watchdog before
		  the payload starts, counts boots that never reach the payload's
		  init and, after a watchdog reset or a boot loop, resets into the
		  other boot slot. The board provides struct failsafe_ops. ARMv8
		  only. See lib/failsafe/failsafe.c.

	config FAILSAFE_SLOT
		int "Boot slot of this image (0 = primary, 1 = secondary)"
		range 0 1
		default 1
		depends on FAILSAFE
		help
		  Samsung: 0 = BOOT, 1 = RECOVERY. Failures reset into the other.

	config FAILSAFE_SCRATCH_ADDR
		hex "Address of 3 scratch words that survive resets"
		depends on FAILSAFE
		help
		  Must be reserved in the payload's device tree. The payload's
		  init writes 0 to this address + 4 once it runs.

	config FAILSAFE_MAX_BOOTS
		int "Boots without reaching init before escaping"
		default 3
		depends on FAILSAFE

	config FAILSAFE_WDT_SEC
		int "Watchdog timeout in seconds (0 = the longest possible)"
		default 0
		depends on FAILSAFE

	config FAILSAFE_WDT_TEST
		bool "Watchdog test: wait for the reset instead of booting"
		default n
		depends on FAILSAFE

	config FAILSAFE_WDT_TEST_SEC
		int "Watchdog timeout for the test"
		default 10
		depends on FAILSAFE_WDT_TEST

	config LIBFDT
		bool "Support for libfdt"
		default y
		help
		  Say Y if you want to have libfdt features.

	config FDT_BUF_SIZE
		int "Size of the static buffer for the Flattened Device Tree"
		default 500000
		depends on LIBFDT
		help
		  This option specifies the size (in bytes) of the buffer used for DTB modifying. The default value of 500 KB should be sufficient even for downstream device trees.

	config FDT_BUF_ADDR
		hex "Address of the buffer for the Flattened Device Tree"
		default 0x0
		depends on LIBFDT
		help
		  If set, the patched DTB is placed at this address instead of a
		  static buffer inside uniLoader. Use this if the kernel overwrites
		  uniLoader before reading the DTB, like an ARMv7 zImage that
		  decompresses over it.
endmenu
```
